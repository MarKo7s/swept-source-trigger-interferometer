/*******************************************************************************
* File Name: cyfittergnu.inc
* 
* PSoC Creator  4.3
*
* Description:
* 
* This file is automatically generated by PSoC Creator.
*
********************************************************************************
* Copyright (c) 2007-2019 Cypress Semiconductor.  All rights reserved.
* You may use this file only in accordance with the license, terms, conditions, 
* disclaimers, and limitations in the end user license agreement accompanying 
* the software package with which this file was provided.
********************************************************************************/

.ifndef INCLUDED_CYFITTERGNU_INC
.set INCLUDED_CYFITTERGNU_INC, 1
.include "cydevicegnu.inc"
.include "cydevicegnu_trm.inc"

/* sw */
.set sw__0__INTTYPE, CYREG_PICU2_INTTYPE2
.set sw__0__MASK, 0x04
.set sw__0__PC, CYREG_PRT2_PC2
.set sw__0__PORT, 2
.set sw__0__SHIFT, 2
.set sw__AG, CYREG_PRT2_AG
.set sw__AMUX, CYREG_PRT2_AMUX
.set sw__BIE, CYREG_PRT2_BIE
.set sw__BIT_MASK, CYREG_PRT2_BIT_MASK
.set sw__BYP, CYREG_PRT2_BYP
.set sw__CTL, CYREG_PRT2_CTL
.set sw__DM0, CYREG_PRT2_DM0
.set sw__DM1, CYREG_PRT2_DM1
.set sw__DM2, CYREG_PRT2_DM2
.set sw__DR, CYREG_PRT2_DR
.set sw__INP_DIS, CYREG_PRT2_INP_DIS
.set sw__INTTYPE_BASE, CYDEV_PICU_INTTYPE_PICU2_BASE
.set sw__LCD_COM_SEG, CYREG_PRT2_LCD_COM_SEG
.set sw__LCD_EN, CYREG_PRT2_LCD_EN
.set sw__MASK, 0x04
.set sw__PORT, 2
.set sw__PRT, CYREG_PRT2_PRT
.set sw__PRTDSI__CAPS_SEL, CYREG_PRT2_CAPS_SEL
.set sw__PRTDSI__DBL_SYNC_IN, CYREG_PRT2_DBL_SYNC_IN
.set sw__PRTDSI__OE_SEL0, CYREG_PRT2_OE_SEL0
.set sw__PRTDSI__OE_SEL1, CYREG_PRT2_OE_SEL1
.set sw__PRTDSI__OUT_SEL0, CYREG_PRT2_OUT_SEL0
.set sw__PRTDSI__OUT_SEL1, CYREG_PRT2_OUT_SEL1
.set sw__PRTDSI__SYNC_OUT, CYREG_PRT2_SYNC_OUT
.set sw__PS, CYREG_PRT2_PS
.set sw__SHIFT, 2
.set sw__SLW, CYREG_PRT2_SLW

/* PWM */
.set PWM_PWMUDB_genblk1_ctrlreg__16BIT_CONTROL_AUX_CTL_REG, CYREG_B0_UDB05_06_ACTL
.set PWM_PWMUDB_genblk1_ctrlreg__16BIT_CONTROL_CONTROL_REG, CYREG_B0_UDB05_06_CTL
.set PWM_PWMUDB_genblk1_ctrlreg__16BIT_CONTROL_COUNT_REG, CYREG_B0_UDB05_06_CTL
.set PWM_PWMUDB_genblk1_ctrlreg__16BIT_COUNT_CONTROL_REG, CYREG_B0_UDB05_06_CTL
.set PWM_PWMUDB_genblk1_ctrlreg__16BIT_COUNT_COUNT_REG, CYREG_B0_UDB05_06_CTL
.set PWM_PWMUDB_genblk1_ctrlreg__16BIT_MASK_MASK_REG, CYREG_B0_UDB05_06_MSK
.set PWM_PWMUDB_genblk1_ctrlreg__16BIT_MASK_PERIOD_REG, CYREG_B0_UDB05_06_MSK
.set PWM_PWMUDB_genblk1_ctrlreg__16BIT_PERIOD_MASK_REG, CYREG_B0_UDB05_06_MSK
.set PWM_PWMUDB_genblk1_ctrlreg__16BIT_PERIOD_PERIOD_REG, CYREG_B0_UDB05_06_MSK
.set PWM_PWMUDB_genblk1_ctrlreg__7__MASK, 0x80
.set PWM_PWMUDB_genblk1_ctrlreg__7__POS, 7
.set PWM_PWMUDB_genblk1_ctrlreg__CONTROL_AUX_CTL_REG, CYREG_B0_UDB05_ACTL
.set PWM_PWMUDB_genblk1_ctrlreg__CONTROL_REG, CYREG_B0_UDB05_CTL
.set PWM_PWMUDB_genblk1_ctrlreg__CONTROL_ST_REG, CYREG_B0_UDB05_ST_CTL
.set PWM_PWMUDB_genblk1_ctrlreg__COUNT_REG, CYREG_B0_UDB05_CTL
.set PWM_PWMUDB_genblk1_ctrlreg__COUNT_ST_REG, CYREG_B0_UDB05_ST_CTL
.set PWM_PWMUDB_genblk1_ctrlreg__MASK, 0x80
.set PWM_PWMUDB_genblk1_ctrlreg__MASK_CTL_AUX_CTL_REG, CYREG_B0_UDB05_MSK_ACTL
.set PWM_PWMUDB_genblk1_ctrlreg__PER_CTL_AUX_CTL_REG, CYREG_B0_UDB05_MSK_ACTL
.set PWM_PWMUDB_genblk1_ctrlreg__PERIOD_REG, CYREG_B0_UDB05_MSK
.set PWM_PWMUDB_genblk8_stsreg__0__MASK, 0x01
.set PWM_PWMUDB_genblk8_stsreg__0__POS, 0
.set PWM_PWMUDB_genblk8_stsreg__16BIT_STATUS_AUX_CTL_REG, CYREG_B0_UDB05_06_ACTL
.set PWM_PWMUDB_genblk8_stsreg__16BIT_STATUS_REG, CYREG_B0_UDB05_06_ST
.set PWM_PWMUDB_genblk8_stsreg__2__MASK, 0x04
.set PWM_PWMUDB_genblk8_stsreg__2__POS, 2
.set PWM_PWMUDB_genblk8_stsreg__3__MASK, 0x08
.set PWM_PWMUDB_genblk8_stsreg__3__POS, 3
.set PWM_PWMUDB_genblk8_stsreg__MASK, 0x0D
.set PWM_PWMUDB_genblk8_stsreg__MASK_REG, CYREG_B0_UDB05_MSK
.set PWM_PWMUDB_genblk8_stsreg__MASK_ST_AUX_CTL_REG, CYREG_B0_UDB05_MSK_ACTL
.set PWM_PWMUDB_genblk8_stsreg__PER_ST_AUX_CTL_REG, CYREG_B0_UDB05_MSK_ACTL
.set PWM_PWMUDB_genblk8_stsreg__STATUS_AUX_CTL_REG, CYREG_B0_UDB05_ACTL
.set PWM_PWMUDB_genblk8_stsreg__STATUS_CNT_REG, CYREG_B0_UDB05_ST_CTL
.set PWM_PWMUDB_genblk8_stsreg__STATUS_CONTROL_REG, CYREG_B0_UDB05_ST_CTL
.set PWM_PWMUDB_genblk8_stsreg__STATUS_REG, CYREG_B0_UDB05_ST
.set PWM_PWMUDB_sP16_pwmdp_u0__16BIT_A0_REG, CYREG_B0_UDB04_05_A0
.set PWM_PWMUDB_sP16_pwmdp_u0__16BIT_A1_REG, CYREG_B0_UDB04_05_A1
.set PWM_PWMUDB_sP16_pwmdp_u0__16BIT_D0_REG, CYREG_B0_UDB04_05_D0
.set PWM_PWMUDB_sP16_pwmdp_u0__16BIT_D1_REG, CYREG_B0_UDB04_05_D1
.set PWM_PWMUDB_sP16_pwmdp_u0__16BIT_DP_AUX_CTL_REG, CYREG_B0_UDB04_05_ACTL
.set PWM_PWMUDB_sP16_pwmdp_u0__16BIT_F0_REG, CYREG_B0_UDB04_05_F0
.set PWM_PWMUDB_sP16_pwmdp_u0__16BIT_F1_REG, CYREG_B0_UDB04_05_F1
.set PWM_PWMUDB_sP16_pwmdp_u0__A0_A1_REG, CYREG_B0_UDB04_A0_A1
.set PWM_PWMUDB_sP16_pwmdp_u0__A0_REG, CYREG_B0_UDB04_A0
.set PWM_PWMUDB_sP16_pwmdp_u0__A1_REG, CYREG_B0_UDB04_A1
.set PWM_PWMUDB_sP16_pwmdp_u0__D0_D1_REG, CYREG_B0_UDB04_D0_D1
.set PWM_PWMUDB_sP16_pwmdp_u0__D0_REG, CYREG_B0_UDB04_D0
.set PWM_PWMUDB_sP16_pwmdp_u0__D1_REG, CYREG_B0_UDB04_D1
.set PWM_PWMUDB_sP16_pwmdp_u0__DP_AUX_CTL_REG, CYREG_B0_UDB04_ACTL
.set PWM_PWMUDB_sP16_pwmdp_u0__F0_F1_REG, CYREG_B0_UDB04_F0_F1
.set PWM_PWMUDB_sP16_pwmdp_u0__F0_REG, CYREG_B0_UDB04_F0
.set PWM_PWMUDB_sP16_pwmdp_u0__F1_REG, CYREG_B0_UDB04_F1
.set PWM_PWMUDB_sP16_pwmdp_u1__16BIT_A0_REG, CYREG_B0_UDB05_06_A0
.set PWM_PWMUDB_sP16_pwmdp_u1__16BIT_A1_REG, CYREG_B0_UDB05_06_A1
.set PWM_PWMUDB_sP16_pwmdp_u1__16BIT_D0_REG, CYREG_B0_UDB05_06_D0
.set PWM_PWMUDB_sP16_pwmdp_u1__16BIT_D1_REG, CYREG_B0_UDB05_06_D1
.set PWM_PWMUDB_sP16_pwmdp_u1__16BIT_DP_AUX_CTL_REG, CYREG_B0_UDB05_06_ACTL
.set PWM_PWMUDB_sP16_pwmdp_u1__16BIT_F0_REG, CYREG_B0_UDB05_06_F0
.set PWM_PWMUDB_sP16_pwmdp_u1__16BIT_F1_REG, CYREG_B0_UDB05_06_F1
.set PWM_PWMUDB_sP16_pwmdp_u1__A0_A1_REG, CYREG_B0_UDB05_A0_A1
.set PWM_PWMUDB_sP16_pwmdp_u1__A0_REG, CYREG_B0_UDB05_A0
.set PWM_PWMUDB_sP16_pwmdp_u1__A1_REG, CYREG_B0_UDB05_A1
.set PWM_PWMUDB_sP16_pwmdp_u1__D0_D1_REG, CYREG_B0_UDB05_D0_D1
.set PWM_PWMUDB_sP16_pwmdp_u1__D0_REG, CYREG_B0_UDB05_D0
.set PWM_PWMUDB_sP16_pwmdp_u1__D1_REG, CYREG_B0_UDB05_D1
.set PWM_PWMUDB_sP16_pwmdp_u1__DP_AUX_CTL_REG, CYREG_B0_UDB05_ACTL
.set PWM_PWMUDB_sP16_pwmdp_u1__F0_F1_REG, CYREG_B0_UDB05_F0_F1
.set PWM_PWMUDB_sP16_pwmdp_u1__F0_REG, CYREG_B0_UDB05_F0
.set PWM_PWMUDB_sP16_pwmdp_u1__F1_REG, CYREG_B0_UDB05_F1
.set PWM_PWMUDB_sP16_pwmdp_u1__MSK_DP_AUX_CTL_REG, CYREG_B0_UDB05_MSK_ACTL
.set PWM_PWMUDB_sP16_pwmdp_u1__PER_DP_AUX_CTL_REG, CYREG_B0_UDB05_MSK_ACTL

/* ref */
.set ref__0__INTTYPE, CYREG_PICU3_INTTYPE6
.set ref__0__MASK, 0x40
.set ref__0__PC, CYREG_PRT3_PC6
.set ref__0__PORT, 3
.set ref__0__SHIFT, 6
.set ref__AG, CYREG_PRT3_AG
.set ref__AMUX, CYREG_PRT3_AMUX
.set ref__BIE, CYREG_PRT3_BIE
.set ref__BIT_MASK, CYREG_PRT3_BIT_MASK
.set ref__BYP, CYREG_PRT3_BYP
.set ref__CTL, CYREG_PRT3_CTL
.set ref__DM0, CYREG_PRT3_DM0
.set ref__DM1, CYREG_PRT3_DM1
.set ref__DM2, CYREG_PRT3_DM2
.set ref__DR, CYREG_PRT3_DR
.set ref__INP_DIS, CYREG_PRT3_INP_DIS
.set ref__INTTYPE_BASE, CYDEV_PICU_INTTYPE_PICU3_BASE
.set ref__LCD_COM_SEG, CYREG_PRT3_LCD_COM_SEG
.set ref__LCD_EN, CYREG_PRT3_LCD_EN
.set ref__MASK, 0x40
.set ref__PORT, 3
.set ref__PRT, CYREG_PRT3_PRT
.set ref__PRTDSI__CAPS_SEL, CYREG_PRT3_CAPS_SEL
.set ref__PRTDSI__DBL_SYNC_IN, CYREG_PRT3_DBL_SYNC_IN
.set ref__PRTDSI__OE_SEL0, CYREG_PRT3_OE_SEL0
.set ref__PRTDSI__OE_SEL1, CYREG_PRT3_OE_SEL1
.set ref__PRTDSI__OUT_SEL0, CYREG_PRT3_OUT_SEL0
.set ref__PRTDSI__OUT_SEL1, CYREG_PRT3_OUT_SEL1
.set ref__PRTDSI__SYNC_OUT, CYREG_PRT3_SYNC_OUT
.set ref__PS, CYREG_PRT3_PS
.set ref__SHIFT, 6
.set ref__SLW, CYREG_PRT3_SLW

/* Comp */
.set Comp_ctComp__CLK, CYREG_CMP2_CLK
.set Comp_ctComp__CMP_MASK, 0x04
.set Comp_ctComp__CMP_NUMBER, 2
.set Comp_ctComp__CR, CYREG_CMP2_CR
.set Comp_ctComp__LUT__CR, CYREG_LUT2_CR
.set Comp_ctComp__LUT__MSK, CYREG_LUT_MSK
.set Comp_ctComp__LUT__MSK_MASK, 0x04
.set Comp_ctComp__LUT__MSK_SHIFT, 2
.set Comp_ctComp__LUT__MX, CYREG_LUT2_MX
.set Comp_ctComp__LUT__SR, CYREG_LUT_SR
.set Comp_ctComp__LUT__SR_MASK, 0x04
.set Comp_ctComp__LUT__SR_SHIFT, 2
.set Comp_ctComp__PM_ACT_CFG, CYREG_PM_ACT_CFG7
.set Comp_ctComp__PM_ACT_MSK, 0x04
.set Comp_ctComp__PM_STBY_CFG, CYREG_PM_STBY_CFG7
.set Comp_ctComp__PM_STBY_MSK, 0x04
.set Comp_ctComp__SW0, CYREG_CMP2_SW0
.set Comp_ctComp__SW2, CYREG_CMP2_SW2
.set Comp_ctComp__SW3, CYREG_CMP2_SW3
.set Comp_ctComp__SW4, CYREG_CMP2_SW4
.set Comp_ctComp__SW6, CYREG_CMP2_SW6
.set Comp_ctComp__TR0, CYREG_CMP2_TR0
.set Comp_ctComp__TR1, CYREG_CMP2_TR1
.set Comp_ctComp__TRIM__TR0, CYREG_FLSHID_MFG_CFG_CMP2_TR0
.set Comp_ctComp__TRIM__TR0_HS, CYREG_FLSHID_CUST_TABLES_CMP2_TR0_HS
.set Comp_ctComp__TRIM__TR1, CYREG_FLSHID_MFG_CFG_CMP2_TR1
.set Comp_ctComp__TRIM__TR1_HS, CYREG_FLSHID_CUST_TABLES_CMP2_TR1_HS
.set Comp_ctComp__WRK, CYREG_CMP_WRK
.set Comp_ctComp__WRK_MASK, 0x04
.set Comp_ctComp__WRK_SHIFT, 2

/* Rx_1 */
.set Rx_1__0__INTTYPE, CYREG_PICU12_INTTYPE6
.set Rx_1__0__MASK, 0x40
.set Rx_1__0__PC, CYREG_PRT12_PC6
.set Rx_1__0__PORT, 12
.set Rx_1__0__SHIFT, 6
.set Rx_1__AG, CYREG_PRT12_AG
.set Rx_1__BIE, CYREG_PRT12_BIE
.set Rx_1__BIT_MASK, CYREG_PRT12_BIT_MASK
.set Rx_1__BYP, CYREG_PRT12_BYP
.set Rx_1__DM0, CYREG_PRT12_DM0
.set Rx_1__DM1, CYREG_PRT12_DM1
.set Rx_1__DM2, CYREG_PRT12_DM2
.set Rx_1__DR, CYREG_PRT12_DR
.set Rx_1__INP_DIS, CYREG_PRT12_INP_DIS
.set Rx_1__INTTYPE_BASE, CYDEV_PICU_INTTYPE_PICU12_BASE
.set Rx_1__MASK, 0x40
.set Rx_1__PORT, 12
.set Rx_1__PRT, CYREG_PRT12_PRT
.set Rx_1__PRTDSI__DBL_SYNC_IN, CYREG_PRT12_DBL_SYNC_IN
.set Rx_1__PRTDSI__OE_SEL0, CYREG_PRT12_OE_SEL0
.set Rx_1__PRTDSI__OE_SEL1, CYREG_PRT12_OE_SEL1
.set Rx_1__PRTDSI__OUT_SEL0, CYREG_PRT12_OUT_SEL0
.set Rx_1__PRTDSI__OUT_SEL1, CYREG_PRT12_OUT_SEL1
.set Rx_1__PRTDSI__SYNC_OUT, CYREG_PRT12_SYNC_OUT
.set Rx_1__PS, CYREG_PRT12_PS
.set Rx_1__SHIFT, 6
.set Rx_1__SIO_CFG, CYREG_PRT12_SIO_CFG
.set Rx_1__SIO_DIFF, CYREG_PRT12_SIO_DIFF
.set Rx_1__SIO_HYST_EN, CYREG_PRT12_SIO_HYST_EN
.set Rx_1__SIO_REG_HIFREQ, CYREG_PRT12_SIO_REG_HIFREQ
.set Rx_1__SLW, CYREG_PRT12_SLW

/* Tx_1 */
.set Tx_1__0__INTTYPE, CYREG_PICU12_INTTYPE7
.set Tx_1__0__MASK, 0x80
.set Tx_1__0__PC, CYREG_PRT12_PC7
.set Tx_1__0__PORT, 12
.set Tx_1__0__SHIFT, 7
.set Tx_1__AG, CYREG_PRT12_AG
.set Tx_1__BIE, CYREG_PRT12_BIE
.set Tx_1__BIT_MASK, CYREG_PRT12_BIT_MASK
.set Tx_1__BYP, CYREG_PRT12_BYP
.set Tx_1__DM0, CYREG_PRT12_DM0
.set Tx_1__DM1, CYREG_PRT12_DM1
.set Tx_1__DM2, CYREG_PRT12_DM2
.set Tx_1__DR, CYREG_PRT12_DR
.set Tx_1__INP_DIS, CYREG_PRT12_INP_DIS
.set Tx_1__INTTYPE_BASE, CYDEV_PICU_INTTYPE_PICU12_BASE
.set Tx_1__MASK, 0x80
.set Tx_1__PORT, 12
.set Tx_1__PRT, CYREG_PRT12_PRT
.set Tx_1__PRTDSI__DBL_SYNC_IN, CYREG_PRT12_DBL_SYNC_IN
.set Tx_1__PRTDSI__OE_SEL0, CYREG_PRT12_OE_SEL0
.set Tx_1__PRTDSI__OE_SEL1, CYREG_PRT12_OE_SEL1
.set Tx_1__PRTDSI__OUT_SEL0, CYREG_PRT12_OUT_SEL0
.set Tx_1__PRTDSI__OUT_SEL1, CYREG_PRT12_OUT_SEL1
.set Tx_1__PRTDSI__SYNC_OUT, CYREG_PRT12_SYNC_OUT
.set Tx_1__PS, CYREG_PRT12_PS
.set Tx_1__SHIFT, 7
.set Tx_1__SIO_CFG, CYREG_PRT12_SIO_CFG
.set Tx_1__SIO_DIFF, CYREG_PRT12_SIO_DIFF
.set Tx_1__SIO_HYST_EN, CYREG_PRT12_SIO_HYST_EN
.set Tx_1__SIO_REG_HIFREQ, CYREG_PRT12_SIO_REG_HIFREQ
.set Tx_1__SLW, CYREG_PRT12_SLW

/* UART */
.set UART_BUART_sRX_RxBitCounter__16BIT_CONTROL_AUX_CTL_REG, CYREG_B0_UDB10_11_ACTL
.set UART_BUART_sRX_RxBitCounter__16BIT_CONTROL_CONTROL_REG, CYREG_B0_UDB10_11_CTL
.set UART_BUART_sRX_RxBitCounter__16BIT_CONTROL_COUNT_REG, CYREG_B0_UDB10_11_CTL
.set UART_BUART_sRX_RxBitCounter__16BIT_COUNT_CONTROL_REG, CYREG_B0_UDB10_11_CTL
.set UART_BUART_sRX_RxBitCounter__16BIT_COUNT_COUNT_REG, CYREG_B0_UDB10_11_CTL
.set UART_BUART_sRX_RxBitCounter__16BIT_MASK_MASK_REG, CYREG_B0_UDB10_11_MSK
.set UART_BUART_sRX_RxBitCounter__16BIT_MASK_PERIOD_REG, CYREG_B0_UDB10_11_MSK
.set UART_BUART_sRX_RxBitCounter__16BIT_PERIOD_MASK_REG, CYREG_B0_UDB10_11_MSK
.set UART_BUART_sRX_RxBitCounter__16BIT_PERIOD_PERIOD_REG, CYREG_B0_UDB10_11_MSK
.set UART_BUART_sRX_RxBitCounter__CONTROL_AUX_CTL_REG, CYREG_B0_UDB10_ACTL
.set UART_BUART_sRX_RxBitCounter__CONTROL_REG, CYREG_B0_UDB10_CTL
.set UART_BUART_sRX_RxBitCounter__CONTROL_ST_REG, CYREG_B0_UDB10_ST_CTL
.set UART_BUART_sRX_RxBitCounter__COUNT_REG, CYREG_B0_UDB10_CTL
.set UART_BUART_sRX_RxBitCounter__COUNT_ST_REG, CYREG_B0_UDB10_ST_CTL
.set UART_BUART_sRX_RxBitCounter__MASK_CTL_AUX_CTL_REG, CYREG_B0_UDB10_MSK_ACTL
.set UART_BUART_sRX_RxBitCounter__PER_CTL_AUX_CTL_REG, CYREG_B0_UDB10_MSK_ACTL
.set UART_BUART_sRX_RxBitCounter__PERIOD_REG, CYREG_B0_UDB10_MSK
.set UART_BUART_sRX_RxBitCounter_ST__16BIT_STATUS_AUX_CTL_REG, CYREG_B0_UDB10_11_ACTL
.set UART_BUART_sRX_RxBitCounter_ST__16BIT_STATUS_REG, CYREG_B0_UDB10_11_ST
.set UART_BUART_sRX_RxBitCounter_ST__MASK_REG, CYREG_B0_UDB10_MSK
.set UART_BUART_sRX_RxBitCounter_ST__MASK_ST_AUX_CTL_REG, CYREG_B0_UDB10_MSK_ACTL
.set UART_BUART_sRX_RxBitCounter_ST__PER_ST_AUX_CTL_REG, CYREG_B0_UDB10_MSK_ACTL
.set UART_BUART_sRX_RxBitCounter_ST__STATUS_AUX_CTL_REG, CYREG_B0_UDB10_ACTL
.set UART_BUART_sRX_RxBitCounter_ST__STATUS_CNT_REG, CYREG_B0_UDB10_ST_CTL
.set UART_BUART_sRX_RxBitCounter_ST__STATUS_CONTROL_REG, CYREG_B0_UDB10_ST_CTL
.set UART_BUART_sRX_RxBitCounter_ST__STATUS_REG, CYREG_B0_UDB10_ST
.set UART_BUART_sRX_RxShifter_u0__16BIT_A0_REG, CYREG_B0_UDB09_10_A0
.set UART_BUART_sRX_RxShifter_u0__16BIT_A1_REG, CYREG_B0_UDB09_10_A1
.set UART_BUART_sRX_RxShifter_u0__16BIT_D0_REG, CYREG_B0_UDB09_10_D0
.set UART_BUART_sRX_RxShifter_u0__16BIT_D1_REG, CYREG_B0_UDB09_10_D1
.set UART_BUART_sRX_RxShifter_u0__16BIT_DP_AUX_CTL_REG, CYREG_B0_UDB09_10_ACTL
.set UART_BUART_sRX_RxShifter_u0__16BIT_F0_REG, CYREG_B0_UDB09_10_F0
.set UART_BUART_sRX_RxShifter_u0__16BIT_F1_REG, CYREG_B0_UDB09_10_F1
.set UART_BUART_sRX_RxShifter_u0__A0_A1_REG, CYREG_B0_UDB09_A0_A1
.set UART_BUART_sRX_RxShifter_u0__A0_REG, CYREG_B0_UDB09_A0
.set UART_BUART_sRX_RxShifter_u0__A1_REG, CYREG_B0_UDB09_A1
.set UART_BUART_sRX_RxShifter_u0__D0_D1_REG, CYREG_B0_UDB09_D0_D1
.set UART_BUART_sRX_RxShifter_u0__D0_REG, CYREG_B0_UDB09_D0
.set UART_BUART_sRX_RxShifter_u0__D1_REG, CYREG_B0_UDB09_D1
.set UART_BUART_sRX_RxShifter_u0__DP_AUX_CTL_REG, CYREG_B0_UDB09_ACTL
.set UART_BUART_sRX_RxShifter_u0__F0_F1_REG, CYREG_B0_UDB09_F0_F1
.set UART_BUART_sRX_RxShifter_u0__F0_REG, CYREG_B0_UDB09_F0
.set UART_BUART_sRX_RxShifter_u0__F1_REG, CYREG_B0_UDB09_F1
.set UART_BUART_sRX_RxSts__16BIT_STATUS_AUX_CTL_REG, CYREG_B0_UDB09_10_ACTL
.set UART_BUART_sRX_RxSts__16BIT_STATUS_REG, CYREG_B0_UDB09_10_ST
.set UART_BUART_sRX_RxSts__3__MASK, 0x08
.set UART_BUART_sRX_RxSts__3__POS, 3
.set UART_BUART_sRX_RxSts__4__MASK, 0x10
.set UART_BUART_sRX_RxSts__4__POS, 4
.set UART_BUART_sRX_RxSts__5__MASK, 0x20
.set UART_BUART_sRX_RxSts__5__POS, 5
.set UART_BUART_sRX_RxSts__MASK, 0x38
.set UART_BUART_sRX_RxSts__MASK_REG, CYREG_B0_UDB09_MSK
.set UART_BUART_sRX_RxSts__STATUS_AUX_CTL_REG, CYREG_B0_UDB09_ACTL
.set UART_BUART_sRX_RxSts__STATUS_REG, CYREG_B0_UDB09_ST
.set UART_BUART_sTX_sCLOCK_TxBitClkGen__16BIT_A0_REG, CYREG_B1_UDB10_11_A0
.set UART_BUART_sTX_sCLOCK_TxBitClkGen__16BIT_A1_REG, CYREG_B1_UDB10_11_A1
.set UART_BUART_sTX_sCLOCK_TxBitClkGen__16BIT_D0_REG, CYREG_B1_UDB10_11_D0
.set UART_BUART_sTX_sCLOCK_TxBitClkGen__16BIT_D1_REG, CYREG_B1_UDB10_11_D1
.set UART_BUART_sTX_sCLOCK_TxBitClkGen__16BIT_DP_AUX_CTL_REG, CYREG_B1_UDB10_11_ACTL
.set UART_BUART_sTX_sCLOCK_TxBitClkGen__16BIT_F0_REG, CYREG_B1_UDB10_11_F0
.set UART_BUART_sTX_sCLOCK_TxBitClkGen__16BIT_F1_REG, CYREG_B1_UDB10_11_F1
.set UART_BUART_sTX_sCLOCK_TxBitClkGen__A0_A1_REG, CYREG_B1_UDB10_A0_A1
.set UART_BUART_sTX_sCLOCK_TxBitClkGen__A0_REG, CYREG_B1_UDB10_A0
.set UART_BUART_sTX_sCLOCK_TxBitClkGen__A1_REG, CYREG_B1_UDB10_A1
.set UART_BUART_sTX_sCLOCK_TxBitClkGen__D0_D1_REG, CYREG_B1_UDB10_D0_D1
.set UART_BUART_sTX_sCLOCK_TxBitClkGen__D0_REG, CYREG_B1_UDB10_D0
.set UART_BUART_sTX_sCLOCK_TxBitClkGen__D1_REG, CYREG_B1_UDB10_D1
.set UART_BUART_sTX_sCLOCK_TxBitClkGen__DP_AUX_CTL_REG, CYREG_B1_UDB10_ACTL
.set UART_BUART_sTX_sCLOCK_TxBitClkGen__F0_F1_REG, CYREG_B1_UDB10_F0_F1
.set UART_BUART_sTX_sCLOCK_TxBitClkGen__F0_REG, CYREG_B1_UDB10_F0
.set UART_BUART_sTX_sCLOCK_TxBitClkGen__F1_REG, CYREG_B1_UDB10_F1
.set UART_BUART_sTX_TxShifter_u0__16BIT_A0_REG, CYREG_B1_UDB09_10_A0
.set UART_BUART_sTX_TxShifter_u0__16BIT_A1_REG, CYREG_B1_UDB09_10_A1
.set UART_BUART_sTX_TxShifter_u0__16BIT_D0_REG, CYREG_B1_UDB09_10_D0
.set UART_BUART_sTX_TxShifter_u0__16BIT_D1_REG, CYREG_B1_UDB09_10_D1
.set UART_BUART_sTX_TxShifter_u0__16BIT_DP_AUX_CTL_REG, CYREG_B1_UDB09_10_ACTL
.set UART_BUART_sTX_TxShifter_u0__16BIT_F0_REG, CYREG_B1_UDB09_10_F0
.set UART_BUART_sTX_TxShifter_u0__16BIT_F1_REG, CYREG_B1_UDB09_10_F1
.set UART_BUART_sTX_TxShifter_u0__A0_A1_REG, CYREG_B1_UDB09_A0_A1
.set UART_BUART_sTX_TxShifter_u0__A0_REG, CYREG_B1_UDB09_A0
.set UART_BUART_sTX_TxShifter_u0__A1_REG, CYREG_B1_UDB09_A1
.set UART_BUART_sTX_TxShifter_u0__D0_D1_REG, CYREG_B1_UDB09_D0_D1
.set UART_BUART_sTX_TxShifter_u0__D0_REG, CYREG_B1_UDB09_D0
.set UART_BUART_sTX_TxShifter_u0__D1_REG, CYREG_B1_UDB09_D1
.set UART_BUART_sTX_TxShifter_u0__DP_AUX_CTL_REG, CYREG_B1_UDB09_ACTL
.set UART_BUART_sTX_TxShifter_u0__F0_F1_REG, CYREG_B1_UDB09_F0_F1
.set UART_BUART_sTX_TxShifter_u0__F0_REG, CYREG_B1_UDB09_F0
.set UART_BUART_sTX_TxShifter_u0__F1_REG, CYREG_B1_UDB09_F1
.set UART_BUART_sTX_TxSts__0__MASK, 0x01
.set UART_BUART_sTX_TxSts__0__POS, 0
.set UART_BUART_sTX_TxSts__1__MASK, 0x02
.set UART_BUART_sTX_TxSts__1__POS, 1
.set UART_BUART_sTX_TxSts__16BIT_STATUS_AUX_CTL_REG, CYREG_B1_UDB09_10_ACTL
.set UART_BUART_sTX_TxSts__16BIT_STATUS_REG, CYREG_B1_UDB09_10_ST
.set UART_BUART_sTX_TxSts__2__MASK, 0x04
.set UART_BUART_sTX_TxSts__2__POS, 2
.set UART_BUART_sTX_TxSts__3__MASK, 0x08
.set UART_BUART_sTX_TxSts__3__POS, 3
.set UART_BUART_sTX_TxSts__MASK, 0x0F
.set UART_BUART_sTX_TxSts__MASK_REG, CYREG_B1_UDB09_MSK
.set UART_BUART_sTX_TxSts__STATUS_AUX_CTL_REG, CYREG_B1_UDB09_ACTL
.set UART_BUART_sTX_TxSts__STATUS_REG, CYREG_B1_UDB09_ST
.set UART_IntClock__CFG0, CYREG_CLKDIST_DCFG1_CFG0
.set UART_IntClock__CFG1, CYREG_CLKDIST_DCFG1_CFG1
.set UART_IntClock__CFG2, CYREG_CLKDIST_DCFG1_CFG2
.set UART_IntClock__CFG2_SRC_SEL_MASK, 0x07
.set UART_IntClock__INDEX, 0x01
.set UART_IntClock__PM_ACT_CFG, CYREG_PM_ACT_CFG2
.set UART_IntClock__PM_ACT_MSK, 0x02
.set UART_IntClock__PM_STBY_CFG, CYREG_PM_STBY_CFG2
.set UART_IntClock__PM_STBY_MSK, 0x02

/* Timer */
.set Timer_TimerHW__CAP0, CYREG_TMR0_CAP0
.set Timer_TimerHW__CAP1, CYREG_TMR0_CAP1
.set Timer_TimerHW__CFG0, CYREG_TMR0_CFG0
.set Timer_TimerHW__CFG1, CYREG_TMR0_CFG1
.set Timer_TimerHW__CFG2, CYREG_TMR0_CFG2
.set Timer_TimerHW__CNT_CMP0, CYREG_TMR0_CNT_CMP0
.set Timer_TimerHW__CNT_CMP1, CYREG_TMR0_CNT_CMP1
.set Timer_TimerHW__PER0, CYREG_TMR0_PER0
.set Timer_TimerHW__PER1, CYREG_TMR0_PER1
.set Timer_TimerHW__PM_ACT_CFG, CYREG_PM_ACT_CFG3
.set Timer_TimerHW__PM_ACT_MSK, 0x01
.set Timer_TimerHW__PM_STBY_CFG, CYREG_PM_STBY_CFG3
.set Timer_TimerHW__PM_STBY_MSK, 0x01
.set Timer_TimerHW__RT0, CYREG_TMR0_RT0
.set Timer_TimerHW__RT1, CYREG_TMR0_RT1
.set Timer_TimerHW__SR0, CYREG_TMR0_SR0

/* BPD_in */
.set BPD_in__0__INTTYPE, CYREG_PICU0_INTTYPE6
.set BPD_in__0__MASK, 0x40
.set BPD_in__0__PC, CYREG_PRT0_PC6
.set BPD_in__0__PORT, 0
.set BPD_in__0__SHIFT, 6
.set BPD_in__AG, CYREG_PRT0_AG
.set BPD_in__AMUX, CYREG_PRT0_AMUX
.set BPD_in__BIE, CYREG_PRT0_BIE
.set BPD_in__BIT_MASK, CYREG_PRT0_BIT_MASK
.set BPD_in__BYP, CYREG_PRT0_BYP
.set BPD_in__CTL, CYREG_PRT0_CTL
.set BPD_in__DM0, CYREG_PRT0_DM0
.set BPD_in__DM1, CYREG_PRT0_DM1
.set BPD_in__DM2, CYREG_PRT0_DM2
.set BPD_in__DR, CYREG_PRT0_DR
.set BPD_in__INP_DIS, CYREG_PRT0_INP_DIS
.set BPD_in__INTTYPE_BASE, CYDEV_PICU_INTTYPE_PICU0_BASE
.set BPD_in__LCD_COM_SEG, CYREG_PRT0_LCD_COM_SEG
.set BPD_in__LCD_EN, CYREG_PRT0_LCD_EN
.set BPD_in__MASK, 0x40
.set BPD_in__PORT, 0
.set BPD_in__PRT, CYREG_PRT0_PRT
.set BPD_in__PRTDSI__CAPS_SEL, CYREG_PRT0_CAPS_SEL
.set BPD_in__PRTDSI__DBL_SYNC_IN, CYREG_PRT0_DBL_SYNC_IN
.set BPD_in__PRTDSI__OE_SEL0, CYREG_PRT0_OE_SEL0
.set BPD_in__PRTDSI__OE_SEL1, CYREG_PRT0_OE_SEL1
.set BPD_in__PRTDSI__OUT_SEL0, CYREG_PRT0_OUT_SEL0
.set BPD_in__PRTDSI__OUT_SEL1, CYREG_PRT0_OUT_SEL1
.set BPD_in__PRTDSI__SYNC_OUT, CYREG_PRT0_SYNC_OUT
.set BPD_in__PS, CYREG_PRT0_PS
.set BPD_in__SHIFT, 6
.set BPD_in__SLW, CYREG_PRT0_SLW

/* isr_sw */
.set isr_sw__INTC_CLR_EN_REG, CYREG_NVIC_CLRENA0
.set isr_sw__INTC_CLR_PD_REG, CYREG_NVIC_CLRPEND0
.set isr_sw__INTC_MASK, 0x02
.set isr_sw__INTC_NUMBER, 1
.set isr_sw__INTC_PRIOR_NUM, 7
.set isr_sw__INTC_PRIOR_REG, CYREG_NVIC_PRI_1
.set isr_sw__INTC_SET_EN_REG, CYREG_NVIC_SETENA0
.set isr_sw__INTC_SET_PD_REG, CYREG_NVIC_SETPEND0

/* Clock_1 */
.set Clock_1__CFG0, CYREG_CLKDIST_DCFG0_CFG0
.set Clock_1__CFG1, CYREG_CLKDIST_DCFG0_CFG1
.set Clock_1__CFG2, CYREG_CLKDIST_DCFG0_CFG2
.set Clock_1__CFG2_SRC_SEL_MASK, 0x07
.set Clock_1__INDEX, 0x00
.set Clock_1__PM_ACT_CFG, CYREG_PM_ACT_CFG2
.set Clock_1__PM_ACT_MSK, 0x01
.set Clock_1__PM_STBY_CFG, CYREG_PM_STBY_CFG2
.set Clock_1__PM_STBY_MSK, 0x01

/* Clock_2 */
.set Clock_2__CFG0, CYREG_CLKDIST_DCFG2_CFG0
.set Clock_2__CFG1, CYREG_CLKDIST_DCFG2_CFG1
.set Clock_2__CFG2, CYREG_CLKDIST_DCFG2_CFG2
.set Clock_2__CFG2_SRC_SEL_MASK, 0x07
.set Clock_2__INDEX, 0x02
.set Clock_2__PM_ACT_CFG, CYREG_PM_ACT_CFG2
.set Clock_2__PM_ACT_MSK, 0x04
.set Clock_2__PM_STBY_CFG, CYREG_PM_STBY_CFG2
.set Clock_2__PM_STBY_MSK, 0x04

/* Counter */
.set Counter_CounterUDB_sC16_counterdp_u0__16BIT_A0_REG, CYREG_B0_UDB10_11_A0
.set Counter_CounterUDB_sC16_counterdp_u0__16BIT_A1_REG, CYREG_B0_UDB10_11_A1
.set Counter_CounterUDB_sC16_counterdp_u0__16BIT_D0_REG, CYREG_B0_UDB10_11_D0
.set Counter_CounterUDB_sC16_counterdp_u0__16BIT_D1_REG, CYREG_B0_UDB10_11_D1
.set Counter_CounterUDB_sC16_counterdp_u0__16BIT_DP_AUX_CTL_REG, CYREG_B0_UDB10_11_ACTL
.set Counter_CounterUDB_sC16_counterdp_u0__16BIT_F0_REG, CYREG_B0_UDB10_11_F0
.set Counter_CounterUDB_sC16_counterdp_u0__16BIT_F1_REG, CYREG_B0_UDB10_11_F1
.set Counter_CounterUDB_sC16_counterdp_u0__A0_A1_REG, CYREG_B0_UDB10_A0_A1
.set Counter_CounterUDB_sC16_counterdp_u0__A0_REG, CYREG_B0_UDB10_A0
.set Counter_CounterUDB_sC16_counterdp_u0__A1_REG, CYREG_B0_UDB10_A1
.set Counter_CounterUDB_sC16_counterdp_u0__D0_D1_REG, CYREG_B0_UDB10_D0_D1
.set Counter_CounterUDB_sC16_counterdp_u0__D0_REG, CYREG_B0_UDB10_D0
.set Counter_CounterUDB_sC16_counterdp_u0__D1_REG, CYREG_B0_UDB10_D1
.set Counter_CounterUDB_sC16_counterdp_u0__DP_AUX_CTL_REG, CYREG_B0_UDB10_ACTL
.set Counter_CounterUDB_sC16_counterdp_u0__F0_F1_REG, CYREG_B0_UDB10_F0_F1
.set Counter_CounterUDB_sC16_counterdp_u0__F0_REG, CYREG_B0_UDB10_F0
.set Counter_CounterUDB_sC16_counterdp_u0__F1_REG, CYREG_B0_UDB10_F1
.set Counter_CounterUDB_sC16_counterdp_u0__MSK_DP_AUX_CTL_REG, CYREG_B0_UDB10_MSK_ACTL
.set Counter_CounterUDB_sC16_counterdp_u0__PER_DP_AUX_CTL_REG, CYREG_B0_UDB10_MSK_ACTL
.set Counter_CounterUDB_sC16_counterdp_u1__16BIT_A0_REG, CYREG_B0_UDB11_12_A0
.set Counter_CounterUDB_sC16_counterdp_u1__16BIT_A1_REG, CYREG_B0_UDB11_12_A1
.set Counter_CounterUDB_sC16_counterdp_u1__16BIT_D0_REG, CYREG_B0_UDB11_12_D0
.set Counter_CounterUDB_sC16_counterdp_u1__16BIT_D1_REG, CYREG_B0_UDB11_12_D1
.set Counter_CounterUDB_sC16_counterdp_u1__16BIT_DP_AUX_CTL_REG, CYREG_B0_UDB11_12_ACTL
.set Counter_CounterUDB_sC16_counterdp_u1__16BIT_F0_REG, CYREG_B0_UDB11_12_F0
.set Counter_CounterUDB_sC16_counterdp_u1__16BIT_F1_REG, CYREG_B0_UDB11_12_F1
.set Counter_CounterUDB_sC16_counterdp_u1__A0_A1_REG, CYREG_B0_UDB11_A0_A1
.set Counter_CounterUDB_sC16_counterdp_u1__A0_REG, CYREG_B0_UDB11_A0
.set Counter_CounterUDB_sC16_counterdp_u1__A1_REG, CYREG_B0_UDB11_A1
.set Counter_CounterUDB_sC16_counterdp_u1__D0_D1_REG, CYREG_B0_UDB11_D0_D1
.set Counter_CounterUDB_sC16_counterdp_u1__D0_REG, CYREG_B0_UDB11_D0
.set Counter_CounterUDB_sC16_counterdp_u1__D1_REG, CYREG_B0_UDB11_D1
.set Counter_CounterUDB_sC16_counterdp_u1__DP_AUX_CTL_REG, CYREG_B0_UDB11_ACTL
.set Counter_CounterUDB_sC16_counterdp_u1__F0_F1_REG, CYREG_B0_UDB11_F0_F1
.set Counter_CounterUDB_sC16_counterdp_u1__F0_REG, CYREG_B0_UDB11_F0
.set Counter_CounterUDB_sC16_counterdp_u1__F1_REG, CYREG_B0_UDB11_F1
.set Counter_CounterUDB_sSTSReg_stsreg__0__MASK, 0x01
.set Counter_CounterUDB_sSTSReg_stsreg__0__POS, 0
.set Counter_CounterUDB_sSTSReg_stsreg__1__MASK, 0x02
.set Counter_CounterUDB_sSTSReg_stsreg__1__POS, 1
.set Counter_CounterUDB_sSTSReg_stsreg__16BIT_STATUS_AUX_CTL_REG, CYREG_B0_UDB12_13_ACTL
.set Counter_CounterUDB_sSTSReg_stsreg__16BIT_STATUS_REG, CYREG_B0_UDB12_13_ST
.set Counter_CounterUDB_sSTSReg_stsreg__2__MASK, 0x04
.set Counter_CounterUDB_sSTSReg_stsreg__2__POS, 2
.set Counter_CounterUDB_sSTSReg_stsreg__5__MASK, 0x20
.set Counter_CounterUDB_sSTSReg_stsreg__5__POS, 5
.set Counter_CounterUDB_sSTSReg_stsreg__6__MASK, 0x40
.set Counter_CounterUDB_sSTSReg_stsreg__6__POS, 6
.set Counter_CounterUDB_sSTSReg_stsreg__MASK, 0x67
.set Counter_CounterUDB_sSTSReg_stsreg__MASK_REG, CYREG_B0_UDB12_MSK
.set Counter_CounterUDB_sSTSReg_stsreg__STATUS_AUX_CTL_REG, CYREG_B0_UDB12_ACTL
.set Counter_CounterUDB_sSTSReg_stsreg__STATUS_REG, CYREG_B0_UDB12_ST

/* count_out */
.set count_out__0__INTTYPE, CYREG_PICU12_INTTYPE3
.set count_out__0__MASK, 0x08
.set count_out__0__PC, CYREG_PRT12_PC3
.set count_out__0__PORT, 12
.set count_out__0__SHIFT, 3
.set count_out__AG, CYREG_PRT12_AG
.set count_out__BIE, CYREG_PRT12_BIE
.set count_out__BIT_MASK, CYREG_PRT12_BIT_MASK
.set count_out__BYP, CYREG_PRT12_BYP
.set count_out__DM0, CYREG_PRT12_DM0
.set count_out__DM1, CYREG_PRT12_DM1
.set count_out__DM2, CYREG_PRT12_DM2
.set count_out__DR, CYREG_PRT12_DR
.set count_out__INP_DIS, CYREG_PRT12_INP_DIS
.set count_out__INTTYPE_BASE, CYDEV_PICU_INTTYPE_PICU12_BASE
.set count_out__MASK, 0x08
.set count_out__PORT, 12
.set count_out__PRT, CYREG_PRT12_PRT
.set count_out__PRTDSI__DBL_SYNC_IN, CYREG_PRT12_DBL_SYNC_IN
.set count_out__PRTDSI__OE_SEL0, CYREG_PRT12_OE_SEL0
.set count_out__PRTDSI__OE_SEL1, CYREG_PRT12_OE_SEL1
.set count_out__PRTDSI__OUT_SEL0, CYREG_PRT12_OUT_SEL0
.set count_out__PRTDSI__OUT_SEL1, CYREG_PRT12_OUT_SEL1
.set count_out__PRTDSI__SYNC_OUT, CYREG_PRT12_SYNC_OUT
.set count_out__PS, CYREG_PRT12_PS
.set count_out__SHIFT, 3
.set count_out__SIO_CFG, CYREG_PRT12_SIO_CFG
.set count_out__SIO_DIFF, CYREG_PRT12_SIO_DIFF
.set count_out__SIO_HYST_EN, CYREG_PRT12_SIO_HYST_EN
.set count_out__SIO_REG_HIFREQ, CYREG_PRT12_SIO_REG_HIFREQ
.set count_out__SLW, CYREG_PRT12_SLW

/* isr_count */
.set isr_count__INTC_CLR_EN_REG, CYREG_NVIC_CLRENA0
.set isr_count__INTC_CLR_PD_REG, CYREG_NVIC_CLRPEND0
.set isr_count__INTC_MASK, 0x01
.set isr_count__INTC_NUMBER, 0
.set isr_count__INTC_PRIOR_NUM, 7
.set isr_count__INTC_PRIOR_REG, CYREG_NVIC_PRI_0
.set isr_count__INTC_SET_EN_REG, CYREG_NVIC_SETENA0
.set isr_count__INTC_SET_PD_REG, CYREG_NVIC_SETPEND0

/* isr_timer */
.set isr_timer__INTC_CLR_EN_REG, CYREG_NVIC_CLRENA0
.set isr_timer__INTC_CLR_PD_REG, CYREG_NVIC_CLRPEND0
.set isr_timer__INTC_MASK, 0x04
.set isr_timer__INTC_NUMBER, 2
.set isr_timer__INTC_PRIOR_NUM, 7
.set isr_timer__INTC_PRIOR_REG, CYREG_NVIC_PRI_2
.set isr_timer__INTC_SET_EN_REG, CYREG_NVIC_SETENA0
.set isr_timer__INTC_SET_PD_REG, CYREG_NVIC_SETPEND0

/* freqcounter */
.set freqcounter_CounterUDB_sC32_counterdp_u0__16BIT_A0_REG, CYREG_B0_UDB12_13_A0
.set freqcounter_CounterUDB_sC32_counterdp_u0__16BIT_A1_REG, CYREG_B0_UDB12_13_A1
.set freqcounter_CounterUDB_sC32_counterdp_u0__16BIT_D0_REG, CYREG_B0_UDB12_13_D0
.set freqcounter_CounterUDB_sC32_counterdp_u0__16BIT_D1_REG, CYREG_B0_UDB12_13_D1
.set freqcounter_CounterUDB_sC32_counterdp_u0__16BIT_DP_AUX_CTL_REG, CYREG_B0_UDB12_13_ACTL
.set freqcounter_CounterUDB_sC32_counterdp_u0__16BIT_F0_REG, CYREG_B0_UDB12_13_F0
.set freqcounter_CounterUDB_sC32_counterdp_u0__16BIT_F1_REG, CYREG_B0_UDB12_13_F1
.set freqcounter_CounterUDB_sC32_counterdp_u0__A0_A1_REG, CYREG_B0_UDB12_A0_A1
.set freqcounter_CounterUDB_sC32_counterdp_u0__A0_REG, CYREG_B0_UDB12_A0
.set freqcounter_CounterUDB_sC32_counterdp_u0__A1_REG, CYREG_B0_UDB12_A1
.set freqcounter_CounterUDB_sC32_counterdp_u0__D0_D1_REG, CYREG_B0_UDB12_D0_D1
.set freqcounter_CounterUDB_sC32_counterdp_u0__D0_REG, CYREG_B0_UDB12_D0
.set freqcounter_CounterUDB_sC32_counterdp_u0__D1_REG, CYREG_B0_UDB12_D1
.set freqcounter_CounterUDB_sC32_counterdp_u0__DP_AUX_CTL_REG, CYREG_B0_UDB12_ACTL
.set freqcounter_CounterUDB_sC32_counterdp_u0__F0_F1_REG, CYREG_B0_UDB12_F0_F1
.set freqcounter_CounterUDB_sC32_counterdp_u0__F0_REG, CYREG_B0_UDB12_F0
.set freqcounter_CounterUDB_sC32_counterdp_u0__F1_REG, CYREG_B0_UDB12_F1
.set freqcounter_CounterUDB_sC32_counterdp_u1__16BIT_A0_REG, CYREG_B0_UDB13_14_A0
.set freqcounter_CounterUDB_sC32_counterdp_u1__16BIT_A1_REG, CYREG_B0_UDB13_14_A1
.set freqcounter_CounterUDB_sC32_counterdp_u1__16BIT_D0_REG, CYREG_B0_UDB13_14_D0
.set freqcounter_CounterUDB_sC32_counterdp_u1__16BIT_D1_REG, CYREG_B0_UDB13_14_D1
.set freqcounter_CounterUDB_sC32_counterdp_u1__16BIT_DP_AUX_CTL_REG, CYREG_B0_UDB13_14_ACTL
.set freqcounter_CounterUDB_sC32_counterdp_u1__16BIT_F0_REG, CYREG_B0_UDB13_14_F0
.set freqcounter_CounterUDB_sC32_counterdp_u1__16BIT_F1_REG, CYREG_B0_UDB13_14_F1
.set freqcounter_CounterUDB_sC32_counterdp_u1__A0_A1_REG, CYREG_B0_UDB13_A0_A1
.set freqcounter_CounterUDB_sC32_counterdp_u1__A0_REG, CYREG_B0_UDB13_A0
.set freqcounter_CounterUDB_sC32_counterdp_u1__A1_REG, CYREG_B0_UDB13_A1
.set freqcounter_CounterUDB_sC32_counterdp_u1__D0_D1_REG, CYREG_B0_UDB13_D0_D1
.set freqcounter_CounterUDB_sC32_counterdp_u1__D0_REG, CYREG_B0_UDB13_D0
.set freqcounter_CounterUDB_sC32_counterdp_u1__D1_REG, CYREG_B0_UDB13_D1
.set freqcounter_CounterUDB_sC32_counterdp_u1__DP_AUX_CTL_REG, CYREG_B0_UDB13_ACTL
.set freqcounter_CounterUDB_sC32_counterdp_u1__F0_F1_REG, CYREG_B0_UDB13_F0_F1
.set freqcounter_CounterUDB_sC32_counterdp_u1__F0_REG, CYREG_B0_UDB13_F0
.set freqcounter_CounterUDB_sC32_counterdp_u1__F1_REG, CYREG_B0_UDB13_F1
.set freqcounter_CounterUDB_sC32_counterdp_u2__16BIT_A0_REG, CYREG_B0_UDB14_15_A0
.set freqcounter_CounterUDB_sC32_counterdp_u2__16BIT_A1_REG, CYREG_B0_UDB14_15_A1
.set freqcounter_CounterUDB_sC32_counterdp_u2__16BIT_D0_REG, CYREG_B0_UDB14_15_D0
.set freqcounter_CounterUDB_sC32_counterdp_u2__16BIT_D1_REG, CYREG_B0_UDB14_15_D1
.set freqcounter_CounterUDB_sC32_counterdp_u2__16BIT_DP_AUX_CTL_REG, CYREG_B0_UDB14_15_ACTL
.set freqcounter_CounterUDB_sC32_counterdp_u2__16BIT_F0_REG, CYREG_B0_UDB14_15_F0
.set freqcounter_CounterUDB_sC32_counterdp_u2__16BIT_F1_REG, CYREG_B0_UDB14_15_F1
.set freqcounter_CounterUDB_sC32_counterdp_u2__A0_A1_REG, CYREG_B0_UDB14_A0_A1
.set freqcounter_CounterUDB_sC32_counterdp_u2__A0_REG, CYREG_B0_UDB14_A0
.set freqcounter_CounterUDB_sC32_counterdp_u2__A1_REG, CYREG_B0_UDB14_A1
.set freqcounter_CounterUDB_sC32_counterdp_u2__D0_D1_REG, CYREG_B0_UDB14_D0_D1
.set freqcounter_CounterUDB_sC32_counterdp_u2__D0_REG, CYREG_B0_UDB14_D0
.set freqcounter_CounterUDB_sC32_counterdp_u2__D1_REG, CYREG_B0_UDB14_D1
.set freqcounter_CounterUDB_sC32_counterdp_u2__DP_AUX_CTL_REG, CYREG_B0_UDB14_ACTL
.set freqcounter_CounterUDB_sC32_counterdp_u2__F0_F1_REG, CYREG_B0_UDB14_F0_F1
.set freqcounter_CounterUDB_sC32_counterdp_u2__F0_REG, CYREG_B0_UDB14_F0
.set freqcounter_CounterUDB_sC32_counterdp_u2__F1_REG, CYREG_B0_UDB14_F1
.set freqcounter_CounterUDB_sC32_counterdp_u3__A0_A1_REG, CYREG_B0_UDB15_A0_A1
.set freqcounter_CounterUDB_sC32_counterdp_u3__A0_REG, CYREG_B0_UDB15_A0
.set freqcounter_CounterUDB_sC32_counterdp_u3__A1_REG, CYREG_B0_UDB15_A1
.set freqcounter_CounterUDB_sC32_counterdp_u3__D0_D1_REG, CYREG_B0_UDB15_D0_D1
.set freqcounter_CounterUDB_sC32_counterdp_u3__D0_REG, CYREG_B0_UDB15_D0
.set freqcounter_CounterUDB_sC32_counterdp_u3__D1_REG, CYREG_B0_UDB15_D1
.set freqcounter_CounterUDB_sC32_counterdp_u3__DP_AUX_CTL_REG, CYREG_B0_UDB15_ACTL
.set freqcounter_CounterUDB_sC32_counterdp_u3__F0_F1_REG, CYREG_B0_UDB15_F0_F1
.set freqcounter_CounterUDB_sC32_counterdp_u3__F0_REG, CYREG_B0_UDB15_F0
.set freqcounter_CounterUDB_sC32_counterdp_u3__F1_REG, CYREG_B0_UDB15_F1
.set freqcounter_CounterUDB_sSTSReg_stsreg__0__MASK, 0x01
.set freqcounter_CounterUDB_sSTSReg_stsreg__0__POS, 0
.set freqcounter_CounterUDB_sSTSReg_stsreg__1__MASK, 0x02
.set freqcounter_CounterUDB_sSTSReg_stsreg__1__POS, 1
.set freqcounter_CounterUDB_sSTSReg_stsreg__2__MASK, 0x04
.set freqcounter_CounterUDB_sSTSReg_stsreg__2__POS, 2
.set freqcounter_CounterUDB_sSTSReg_stsreg__5__MASK, 0x20
.set freqcounter_CounterUDB_sSTSReg_stsreg__5__POS, 5
.set freqcounter_CounterUDB_sSTSReg_stsreg__6__MASK, 0x40
.set freqcounter_CounterUDB_sSTSReg_stsreg__6__POS, 6
.set freqcounter_CounterUDB_sSTSReg_stsreg__MASK, 0x67
.set freqcounter_CounterUDB_sSTSReg_stsreg__MASK_REG, CYREG_B0_UDB15_MSK
.set freqcounter_CounterUDB_sSTSReg_stsreg__STATUS_AUX_CTL_REG, CYREG_B0_UDB15_ACTL
.set freqcounter_CounterUDB_sSTSReg_stsreg__STATUS_REG, CYREG_B0_UDB15_ST

/* comp_out_monitor */
.set comp_out_monitor__0__INTTYPE, CYREG_PICU0_INTTYPE1
.set comp_out_monitor__0__MASK, 0x02
.set comp_out_monitor__0__PC, CYREG_PRT0_PC1
.set comp_out_monitor__0__PORT, 0
.set comp_out_monitor__0__SHIFT, 1
.set comp_out_monitor__AG, CYREG_PRT0_AG
.set comp_out_monitor__AMUX, CYREG_PRT0_AMUX
.set comp_out_monitor__BIE, CYREG_PRT0_BIE
.set comp_out_monitor__BIT_MASK, CYREG_PRT0_BIT_MASK
.set comp_out_monitor__BYP, CYREG_PRT0_BYP
.set comp_out_monitor__CTL, CYREG_PRT0_CTL
.set comp_out_monitor__DM0, CYREG_PRT0_DM0
.set comp_out_monitor__DM1, CYREG_PRT0_DM1
.set comp_out_monitor__DM2, CYREG_PRT0_DM2
.set comp_out_monitor__DR, CYREG_PRT0_DR
.set comp_out_monitor__INP_DIS, CYREG_PRT0_INP_DIS
.set comp_out_monitor__INTTYPE_BASE, CYDEV_PICU_INTTYPE_PICU0_BASE
.set comp_out_monitor__LCD_COM_SEG, CYREG_PRT0_LCD_COM_SEG
.set comp_out_monitor__LCD_EN, CYREG_PRT0_LCD_EN
.set comp_out_monitor__MASK, 0x02
.set comp_out_monitor__PORT, 0
.set comp_out_monitor__PRT, CYREG_PRT0_PRT
.set comp_out_monitor__PRTDSI__CAPS_SEL, CYREG_PRT0_CAPS_SEL
.set comp_out_monitor__PRTDSI__DBL_SYNC_IN, CYREG_PRT0_DBL_SYNC_IN
.set comp_out_monitor__PRTDSI__OE_SEL0, CYREG_PRT0_OE_SEL0
.set comp_out_monitor__PRTDSI__OE_SEL1, CYREG_PRT0_OE_SEL1
.set comp_out_monitor__PRTDSI__OUT_SEL0, CYREG_PRT0_OUT_SEL0
.set comp_out_monitor__PRTDSI__OUT_SEL1, CYREG_PRT0_OUT_SEL1
.set comp_out_monitor__PRTDSI__SYNC_OUT, CYREG_PRT0_SYNC_OUT
.set comp_out_monitor__PS, CYREG_PRT0_PS
.set comp_out_monitor__SHIFT, 1
.set comp_out_monitor__SLW, CYREG_PRT0_SLW

/* Miscellaneous */
.set BCLK__BUS_CLK__HZ, 24000000
.set BCLK__BUS_CLK__KHZ, 24000
.set BCLK__BUS_CLK__MHZ, 24
.set CYDEV_CHIP_DIE_LEOPARD, 1
.set CYDEV_CHIP_DIE_PSOC4A, 24
.set CYDEV_CHIP_DIE_PSOC5LP, 2
.set CYDEV_CHIP_DIE_PSOC5TM, 3
.set CYDEV_CHIP_DIE_TMA4, 4
.set CYDEV_CHIP_DIE_UNKNOWN, 0
.set CYDEV_CHIP_FAMILY_FM0P, 5
.set CYDEV_CHIP_FAMILY_FM3, 6
.set CYDEV_CHIP_FAMILY_FM4, 7
.set CYDEV_CHIP_FAMILY_PSOC3, 1
.set CYDEV_CHIP_FAMILY_PSOC4, 2
.set CYDEV_CHIP_FAMILY_PSOC5, 3
.set CYDEV_CHIP_FAMILY_PSOC6, 4
.set CYDEV_CHIP_FAMILY_UNKNOWN, 0
.set CYDEV_CHIP_FAMILY_USED, CYDEV_CHIP_FAMILY_PSOC5
.set CYDEV_CHIP_JTAG_ID, 0x2E161069
.set CYDEV_CHIP_MEMBER_3A, 1
.set CYDEV_CHIP_MEMBER_4A, 24
.set CYDEV_CHIP_MEMBER_4AA, 23
.set CYDEV_CHIP_MEMBER_4AB, 28
.set CYDEV_CHIP_MEMBER_4AC, 14
.set CYDEV_CHIP_MEMBER_4D, 18
.set CYDEV_CHIP_MEMBER_4E, 6
.set CYDEV_CHIP_MEMBER_4F, 25
.set CYDEV_CHIP_MEMBER_4G, 4
.set CYDEV_CHIP_MEMBER_4H, 22
.set CYDEV_CHIP_MEMBER_4I, 30
.set CYDEV_CHIP_MEMBER_4J, 19
.set CYDEV_CHIP_MEMBER_4K, 20
.set CYDEV_CHIP_MEMBER_4L, 29
.set CYDEV_CHIP_MEMBER_4M, 27
.set CYDEV_CHIP_MEMBER_4N, 11
.set CYDEV_CHIP_MEMBER_4O, 8
.set CYDEV_CHIP_MEMBER_4P, 26
.set CYDEV_CHIP_MEMBER_4Q, 15
.set CYDEV_CHIP_MEMBER_4R, 9
.set CYDEV_CHIP_MEMBER_4S, 12
.set CYDEV_CHIP_MEMBER_4T, 10
.set CYDEV_CHIP_MEMBER_4U, 5
.set CYDEV_CHIP_MEMBER_4V, 21
.set CYDEV_CHIP_MEMBER_4W, 13
.set CYDEV_CHIP_MEMBER_4X, 7
.set CYDEV_CHIP_MEMBER_4Y, 16
.set CYDEV_CHIP_MEMBER_4Z, 17
.set CYDEV_CHIP_MEMBER_5A, 3
.set CYDEV_CHIP_MEMBER_5B, 2
.set CYDEV_CHIP_MEMBER_6A, 31
.set CYDEV_CHIP_MEMBER_FM3, 35
.set CYDEV_CHIP_MEMBER_FM4, 36
.set CYDEV_CHIP_MEMBER_PDL_FM0P_TYPE1, 32
.set CYDEV_CHIP_MEMBER_PDL_FM0P_TYPE2, 33
.set CYDEV_CHIP_MEMBER_PDL_FM0P_TYPE3, 34
.set CYDEV_CHIP_MEMBER_UNKNOWN, 0
.set CYDEV_CHIP_MEMBER_USED, CYDEV_CHIP_MEMBER_5B
.set CYDEV_CHIP_DIE_EXPECT, CYDEV_CHIP_MEMBER_USED
.set CYDEV_CHIP_DIE_ACTUAL, CYDEV_CHIP_DIE_EXPECT
.set CYDEV_CHIP_REV_LEOPARD_ES1, 0
.set CYDEV_CHIP_REV_LEOPARD_ES2, 1
.set CYDEV_CHIP_REV_LEOPARD_ES3, 3
.set CYDEV_CHIP_REV_LEOPARD_PRODUCTION, 3
.set CYDEV_CHIP_REV_PSOC4A_ES0, 17
.set CYDEV_CHIP_REV_PSOC4A_PRODUCTION, 17
.set CYDEV_CHIP_REV_PSOC5LP_ES0, 0
.set CYDEV_CHIP_REV_PSOC5LP_PRODUCTION, 0
.set CYDEV_CHIP_REV_PSOC5TM_ES0, 0
.set CYDEV_CHIP_REV_PSOC5TM_ES1, 1
.set CYDEV_CHIP_REV_PSOC5TM_PRODUCTION, 1
.set CYDEV_CHIP_REV_TMA4_ES, 17
.set CYDEV_CHIP_REV_TMA4_ES2, 33
.set CYDEV_CHIP_REV_TMA4_PRODUCTION, 17
.set CYDEV_CHIP_REVISION_3A_ES1, 0
.set CYDEV_CHIP_REVISION_3A_ES2, 1
.set CYDEV_CHIP_REVISION_3A_ES3, 3
.set CYDEV_CHIP_REVISION_3A_PRODUCTION, 3
.set CYDEV_CHIP_REVISION_4A_ES0, 17
.set CYDEV_CHIP_REVISION_4A_PRODUCTION, 17
.set CYDEV_CHIP_REVISION_4AA_PRODUCTION, 0
.set CYDEV_CHIP_REVISION_4AB_PRODUCTION, 0
.set CYDEV_CHIP_REVISION_4AC_PRODUCTION, 0
.set CYDEV_CHIP_REVISION_4D_PRODUCTION, 0
.set CYDEV_CHIP_REVISION_4E_CCG2_NO_USBPD, 0
.set CYDEV_CHIP_REVISION_4E_PRODUCTION, 0
.set CYDEV_CHIP_REVISION_4F_PRODUCTION, 0
.set CYDEV_CHIP_REVISION_4F_PRODUCTION_256DMA, 0
.set CYDEV_CHIP_REVISION_4F_PRODUCTION_256K, 0
.set CYDEV_CHIP_REVISION_4G_ES, 17
.set CYDEV_CHIP_REVISION_4G_ES2, 33
.set CYDEV_CHIP_REVISION_4G_PRODUCTION, 17
.set CYDEV_CHIP_REVISION_4H_PRODUCTION, 0
.set CYDEV_CHIP_REVISION_4I_PRODUCTION, 0
.set CYDEV_CHIP_REVISION_4J_PRODUCTION, 0
.set CYDEV_CHIP_REVISION_4K_PRODUCTION, 0
.set CYDEV_CHIP_REVISION_4L_PRODUCTION, 0
.set CYDEV_CHIP_REVISION_4M_PRODUCTION, 0
.set CYDEV_CHIP_REVISION_4N_PRODUCTION, 0
.set CYDEV_CHIP_REVISION_4O_PRODUCTION, 0
.set CYDEV_CHIP_REVISION_4P_PRODUCTION, 0
.set CYDEV_CHIP_REVISION_4Q_PRODUCTION, 0
.set CYDEV_CHIP_REVISION_4R_PRODUCTION, 0
.set CYDEV_CHIP_REVISION_4S_PRODUCTION, 0
.set CYDEV_CHIP_REVISION_4T_PRODUCTION, 0
.set CYDEV_CHIP_REVISION_4U_PRODUCTION, 0
.set CYDEV_CHIP_REVISION_4V_PRODUCTION, 0
.set CYDEV_CHIP_REVISION_4W_PRODUCTION, 0
.set CYDEV_CHIP_REVISION_4X_PRODUCTION, 0
.set CYDEV_CHIP_REVISION_4Y_PRODUCTION, 0
.set CYDEV_CHIP_REVISION_4Z_PRODUCTION, 0
.set CYDEV_CHIP_REVISION_5A_ES0, 0
.set CYDEV_CHIP_REVISION_5A_ES1, 1
.set CYDEV_CHIP_REVISION_5A_PRODUCTION, 1
.set CYDEV_CHIP_REVISION_5B_ES0, 0
.set CYDEV_CHIP_REVISION_5B_PRODUCTION, 0
.set CYDEV_CHIP_REVISION_6A_ES, 17
.set CYDEV_CHIP_REVISION_6A_NO_UDB, 33
.set CYDEV_CHIP_REVISION_6A_PRODUCTION, 33
.set CYDEV_CHIP_REVISION_FM3_PRODUCTION, 0
.set CYDEV_CHIP_REVISION_FM4_PRODUCTION, 0
.set CYDEV_CHIP_REVISION_PDL_FM0P_TYPE1_PRODUCTION, 0
.set CYDEV_CHIP_REVISION_PDL_FM0P_TYPE2_PRODUCTION, 0
.set CYDEV_CHIP_REVISION_PDL_FM0P_TYPE3_PRODUCTION, 0
.set CYDEV_CHIP_REVISION_USED, CYDEV_CHIP_REVISION_5B_PRODUCTION
.set CYDEV_CHIP_REV_EXPECT, CYDEV_CHIP_REVISION_USED
.set CYDEV_CONFIG_FASTBOOT_ENABLED, 1
.set CYDEV_CONFIG_UNUSED_IO_AllowButWarn, 0
.set CYDEV_CONFIG_UNUSED_IO, CYDEV_CONFIG_UNUSED_IO_AllowButWarn
.set CYDEV_CONFIG_UNUSED_IO_AllowWithInfo, 1
.set CYDEV_CONFIG_UNUSED_IO_Disallowed, 2
.set CYDEV_CONFIGURATION_COMPRESSED, 1
.set CYDEV_CONFIGURATION_DMA, 0
.set CYDEV_CONFIGURATION_ECC, 1
.set CYDEV_CONFIGURATION_IMOENABLED, CYDEV_CONFIG_FASTBOOT_ENABLED
.set CYDEV_CONFIGURATION_MODE_COMPRESSED, 0
.set CYDEV_CONFIGURATION_MODE, CYDEV_CONFIGURATION_MODE_COMPRESSED
.set CYDEV_CONFIGURATION_MODE_DMA, 2
.set CYDEV_CONFIGURATION_MODE_UNCOMPRESSED, 1
.set CYDEV_DEBUG_ENABLE_MASK, 0x20
.set CYDEV_DEBUG_ENABLE_REGISTER, CYREG_MLOGIC_DEBUG
.set CYDEV_DEBUGGING_DPS_Disable, 3
.set CYDEV_DEBUGGING_DPS_JTAG_4, 1
.set CYDEV_DEBUGGING_DPS_JTAG_5, 0
.set CYDEV_DEBUGGING_DPS_SWD, 2
.set CYDEV_DEBUGGING_DPS_SWD_SWV, 6
.set CYDEV_DEBUGGING_DPS, CYDEV_DEBUGGING_DPS_SWD_SWV
.set CYDEV_DEBUGGING_ENABLE, 1
.set CYDEV_DEBUGGING_XRES, 0
.set CYDEV_DMA_CHANNELS_AVAILABLE, 24
.set CYDEV_ECC_ENABLE, 0
.set CYDEV_HEAP_SIZE, 0x200
.set CYDEV_INSTRUCT_CACHE_ENABLED, 1
.set CYDEV_INTR_RISING, 0x00000003
.set CYDEV_IS_EXPORTING_CODE, 0
.set CYDEV_IS_IMPORTING_CODE, 0
.set CYDEV_PROJ_TYPE, 0
.set CYDEV_PROJ_TYPE_BOOTLOADER, 1
.set CYDEV_PROJ_TYPE_LAUNCHER, 5
.set CYDEV_PROJ_TYPE_LOADABLE, 2
.set CYDEV_PROJ_TYPE_LOADABLEANDBOOTLOADER, 4
.set CYDEV_PROJ_TYPE_MULTIAPPBOOTLOADER, 3
.set CYDEV_PROJ_TYPE_STANDARD, 0
.set CYDEV_PROTECTION_ENABLE, 0
.set CYDEV_STACK_SIZE, 0x0800
.set CYDEV_USE_BUNDLED_CMSIS, 1
.set CYDEV_VARIABLE_VDDA, 0
.set CYDEV_VDDA_MV, 5000
.set CYDEV_VDDD_MV, 5000
.set CYDEV_VDDIO0_MV, 5000
.set CYDEV_VDDIO1_MV, 5000
.set CYDEV_VDDIO2_MV, 5000
.set CYDEV_VDDIO3_MV, 5000
.set CYDEV_VIO0_MV, 5000
.set CYDEV_VIO1_MV, 5000
.set CYDEV_VIO2_MV, 5000
.set CYDEV_VIO3_MV, 5000
.set CYIPBLOCK_ARM_CM3_VERSION, 0
.set CYIPBLOCK_P3_ANAIF_VERSION, 0
.set CYIPBLOCK_P3_CAN_VERSION, 0
.set CYIPBLOCK_P3_CAPSENSE_VERSION, 0
.set CYIPBLOCK_P3_COMP_VERSION, 0
.set CYIPBLOCK_P3_DECIMATOR_VERSION, 0
.set CYIPBLOCK_P3_DFB_VERSION, 0
.set CYIPBLOCK_P3_DMA_VERSION, 0
.set CYIPBLOCK_P3_DRQ_VERSION, 0
.set CYIPBLOCK_P3_DSM_VERSION, 0
.set CYIPBLOCK_P3_EMIF_VERSION, 0
.set CYIPBLOCK_P3_I2C_VERSION, 0
.set CYIPBLOCK_P3_LCD_VERSION, 0
.set CYIPBLOCK_P3_LPF_VERSION, 0
.set CYIPBLOCK_P3_OPAMP_VERSION, 0
.set CYIPBLOCK_P3_PM_VERSION, 0
.set CYIPBLOCK_P3_SCCT_VERSION, 0
.set CYIPBLOCK_P3_TIMER_VERSION, 0
.set CYIPBLOCK_P3_USB_VERSION, 0
.set CYIPBLOCK_P3_VIDAC_VERSION, 0
.set CYIPBLOCK_P3_VREF_VERSION, 0
.set CYIPBLOCK_S8_GPIO_VERSION, 0
.set CYIPBLOCK_S8_IRQ_VERSION, 0
.set CYIPBLOCK_S8_SAR_VERSION, 0
.set CYIPBLOCK_S8_SIO_VERSION, 0
.set CYIPBLOCK_S8_UDB_VERSION, 0
.set DMA_CHANNELS_USED__MASK0, 0x00000000
.set CYDEV_BOOTLOADER_ENABLE, 0
.endif
